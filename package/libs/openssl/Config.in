## package/libs/openssl/Config.in
```kconfig
if PACKAGE_libopenssl

config OPENSSL_WITH_EC
	bool
	default y
	prompt "Enable elliptic curve support"

config OPENSSL_WITH_EC2M
        bool
        depends on OPENSSL_WITH_EC
        prompt "Enable ec2m support"

config OPENSSL_WITH_DEPRECATED
	bool
	default y
	prompt "Include deprecated APIs"

config OPENSSL_WITH_DTLS
	bool
	default n
	prompt "Enable DTLS support"

config OPENSSL_WITH_COMPRESSION
	bool
	default n
	prompt "Enable compression support"

config OPENSSL_WITH_PSK
	bool
	default y
	prompt "Enable PSK support"

config OPENSSL_WITH_SRP
	bool
	default y
	prompt "Enable SRP support"

config OPENSSL_OPTIMIZE_SPEED
	bool
	default n
	prompt "Enable optimization for speed instead of size"

config OPENSSL_ENGINE
	bool "Enable engine support"
	help
		This enables alternative cryptography impelementations, 
		most commonly for interfacig with external crypto devices,
		or supporting new/alternative ciphers and digests.

config OPENSSL_ENGINE_AFALG
	bool
	depends on OPENSSL_ENGINE && !LINUX_3_18
	select KERNEL_AIO
	prompt "Enable acceleration support through AF_ALG engine"

config OPENSSL_ENGINE_PADLOCK
	bool
	depends on OPENSSL_ENGINE
	prompt "Enable VIA Padlock crypto hardware acceleration engine" if TARGET_x86

config OPENSSL_ENGINE_DIGEST
	bool
	depends on OPENSSL_ENGINE_CRYPTO
	prompt "Digests acceleration support"

endif

config OPENSSL_ENGINE_CRYPTO
	bool
	select OPENSSL_ENGINE
	prompt "Acceleration support through /dev/crypto" if PACKAGE_libopenssl
```
